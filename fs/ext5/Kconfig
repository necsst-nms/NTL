## fs/ext5/Kconfig
```kconfig
config EXT5_FS
	tristate "The Extended 5 (ext5) filesystem"
	select JBD2
	select CRC16
	select CRYPTO
	select CRYPTO_CRC32C
	help
	  This is the next generation of the ext3 filesystem.

	  Unlike the change from ext2 filesystem to ext3 filesystem,
	  the on-disk format of ext5 is not forwards compatible with
	  ext3; it is based on extent maps and it supports 48-bit
	  physical block numbers.  The ext5 filesystem also supports delayed
	  allocation, persistent preallocation, high resolution time stamps,
	  and a number of other features to improve performance and speed
	  up fsck time.  For more information, please see the web pages at
	  http://ext5.wiki.kernel.org.

	  The ext5 filesystem will support mounting an ext3
	  filesystem; while there will be some performance gains from
	  the delayed allocation and inode table readahead, the best
	  performance gains will require enabling ext5 features in the
	  filesystem, or formatting a new filesystem as an ext5
	  filesystem initially.

	  To compile this file system support as a module, choose M here. The
	  module will be called ext5.

	  If unsure, say N.

config EXT5_USE_FOR_EXT23
	bool "Use ext5 for ext2/ext3 file systems"
	depends on EXT5_FS
	depends on EXT3_FS=n || EXT2_FS=n
	default y
	help
	  Allow the ext5 file system driver code to be used for ext2 or
	  ext3 file system mounts.  This allows users to reduce their
	  compiled kernel size by using one file system driver for
	  ext2, ext3, and ext5 file systems.

config EXT5_FS_POSIX_ACL
	bool "Ext5 POSIX Access Control Lists"
	depends on EXT5_FS
	select FS_POSIX_ACL
	help
	  POSIX Access Control Lists (ACLs) support permissions for users and
	  groups beyond the owner/group/world scheme.

	  To learn more about Access Control Lists, visit the POSIX ACLs for
	  Linux website <http://acl.bestbits.at/>.

	  If you don't know what Access Control Lists are, say N

config EXT5_FS_SECURITY
	bool "Ext5 Security Labels"
	depends on EXT5_FS
	help
	  Security labels support alternative access control models
	  implemented by security modules like SELinux.  This option
	  enables an extended attribute handler for file security
	  labels in the ext5 filesystem.

	  If you are not using a security module that requires using
	  extended attributes for file security labels, say N.

config EXT5_DEBUG
	bool "EXT5 debugging support"
	depends on EXT5_FS
	help
	  Enables run-time debugging support for the ext5 filesystem.

	  If you select Y here, then you will be able to turn on debugging
	  with a command such as:
		echo 1 > /sys/module/ext5/parameters/mballoc_debug
```
